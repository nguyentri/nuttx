## boards/arm/ra8/fpb-ra8e1/configs/adc_bms/Kconfig
```kconfig
#
# For a description of the syntax of this configuration file,
# see the file kconfig-language.txt in the NuttX tools repository.
#

config EXAMPLES_ADC_BATTERY
	tristate "ADC Battery Monitor Example"
	default n
	depends on ADC && RA8_ADC_BATTERY_MONITOR
	---help---
		Enable the ADC battery monitor example for FPB-RA8E1.
		This example demonstrates how to use the ADC driver to
		monitor battery voltage and current.

if EXAMPLES_ADC_BATTERY

config EXAMPLES_ADC_BATTERY_PROGNAME
	string "Program name"
	default "adc_battery"
	---help---
		This is the name of the program that will be used when the
		NSH ELF program is installed.

config EXAMPLES_ADC_BATTERY_PRIORITY
	int "ADC Battery task priority"
	default 100

config EXAMPLES_ADC_BATTERY_STACKSIZE
	int "ADC Battery stack size"
	default 2048

endif
```

## boards/arm/ra8/fpb-ra8e1/configs/i2c-gy912/defconfig
```kconfig
#
# SPI Configuration for FPB-RA8E1 with GY-912 sensor support
# 
# This defconfig enables SPI and GY-912 sensor support for the FPB-RA8E1 board
# Add these configurations to your existing defconfig file or use this as a template

# Architecture and Chip Configuration
CONFIG_ARCH="arm"
CONFIG_ARCH_BOARD="fpb-ra8e1"
CONFIG_ARCH_BOARD_FPB_RA8E1=y
CONFIG_ARCH_CHIP="ra8"
CONFIG_ARCH_CHIP_R7FA8E1AFDCFB=y
CONFIG_ARCH_CHIP_RA8=y
CONFIG_ARCH_STACKDUMP=y

# Board Configuration
CONFIG_BOARD_LOOPSPERMSEC=6965

# Clock Configuration
CONFIG_START_DAY=28
CONFIG_START_MONTH=6
CONFIG_START_YEAR=2013

# Memory Configuration
CONFIG_RAM_SIZE=557056
CONFIG_RAM_START=0x20000000

# System Configuration
CONFIG_RR_INTERVAL=200
CONFIG_SCHED_WAITPID=y
CONFIG_TASK_NAME_SIZE=32

# File System Support
CONFIG_FS_PROCFS=y

# Serial/Debug Configuration
CONFIG_SERIAL_RTT0=y
CONFIG_SYSLOG_RTT=y

# Segger SystemView Configuration
CONFIG_SEGGER_SYSVIEW=y
CONFIG_SEGGER_SYSVIEW_RTT_CHANNEL=0
CONFIG_SEGGER_SYSVIEW_RTT_BUFFER_SIZE=1024

# Performance Monitoring
CONFIG_ARCH_PERF_EVENTS=y
CONFIG_STACK_USAGE=y

# Floating Point Support
CONFIG_ARCH_FPU=y

# Build Configuration
CONFIG_BOARDCTL=y
CONFIG_BUILTIN=y
CONFIG_HAVE_CXX=y
CONFIG_HAVE_CXXINITIALIZE=y
CONFIG_INTELHEX_BINARY=y

# Application Configuration
CONFIG_NSH_ARCHINIT=y
CONFIG_NSH_BUILTIN_APPS=y
CONFIG_NSH_DISABLE_IFUPDOWN=y
CONFIG_NSH_FILEIOSIZE=512
CONFIG_NSH_READLINE=y
CONFIG_INIT_ENTRYPOINT="nsh_main"
CONFIG_SYSTEM_NSH=y

# Testing Configuration
CONFIG_TESTING_OSTEST=y
CONFIG_TESTING_OSTEST_NBARRIER_THREADS=3
CONFIG_TESTING_OSTEST_STACKSIZE=2048

# Timer Configuration
CONFIG_PREALLOC_TIMERS=4

# ===== SPI CONFIGURATION =====

# Enable SPI Support
CONFIG_SPI=y
CONFIG_SPI_EXCHANGE=y
CONFIG_SPI_CMDDATA=y
CONFIG_SPI_CALLBACK=y

# RA8 SPI Configuration
CONFIG_RA_SPI=y
CONFIG_RA_SPI0=y
CONFIG_RA_SPI0_DMA=y

# DMAC Configuration
CONFIG_RA_DMAC=y
CONFIG_RA_DMAC_CHANNELS=8

# ===== SENSOR CONFIGURATION =====

# Enable Sensor Support
CONFIG_SENSORS=y
CONFIG_RA8E1_SPI_GY912_DEMO=y
CONFIG_GY912_SPI_FREQUENCY=1000000
CONFIG_GY912_USE_DMA=y

# Debug Configuration for Sensors
CONFIG_DEBUG_FEATURES=y
CONFIG_DEBUG_INFO=y
CONFIG_DEBUG_SENSORS=y
CONFIG_DEBUG_SENSORS_INFO=y
CONFIG_DEBUG_SPI=y
CONFIG_DEBUG_SPI_INFO=y
CONFIG_GY912_DEBUG=y

# ===== APPLICATION CONFIGURATION =====

# Examples
CONFIG_EXAMPLES_SPI_GY912=y

# Enable the GY-912 test application
CONFIG_EXAMPLES_GY912_TEST=y

# System Commands
CONFIG_SYSTEM_RAMTEST=y
CONFIG_SYSTEM_STACKMONITOR=y

# ===== ADVANCED CONFIGURATION =====

# Memory debugging
CONFIG_DEBUG_MM=y

# Stack monitoring
CONFIG_STACK_COLORATION=y

# Performance monitoring
CONFIG_SCHED_INSTRUMENTATION=y

# Error handling
CONFIG_ARCH_HAVE_STACKCHECK=y
CONFIG_STACK_CHECKING=y
```
